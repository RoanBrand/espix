## components/espix_audio/Kconfig
```kconfig
menu "espix audio"

    config ESPIX_AUDIO
        bool "Audio system"
        default y
        help
            The audio engine and the "play" command: a URI or a file is
            decoded and its PCM is fed to a registered sink.

            Independent of Bluetooth on purpose. A sink is registered by
            whatever provides it (A2DP today, an I2S codec or the RF
            transmitters next), and a build with no sink still compiles and
            links -- "play" reports that none is available. This is what lets
            an S3 build carry audio without the Bluetooth stack.

    config ESPIX_AUDIO_SINK_BT_A2DP
        bool "Bluetooth A2DP sink"
        depends on ESPIX_AUDIO && ESPIX_BT
        default y
        help
            The A2DP source, published to the engine as the "a2dp" sink. It
            needs a Bluetooth host that supports Classic (Bluedroid), so it is
            off wherever ESPIX_BT is; the engine itself is not.

    config ESPIX_AUDIO_NULL_SINK
        bool "Null sink (benchmark; discards PCM)"
        depends on ESPIX_AUDIO
        default n
        help
            A sink that accepts PCM as fast as it is produced and throws it
            away. It exists to measure the source and decoder with no
            Bluetooth, no I2S and no radio in the picture: build with
            ESPIX_AUDIO_SINK_BT_A2DP off and this is the default sink. Not for
            a release -- "play" finishes as fast as the decoder can run, and
            only the telemetry is meaningful.

    config ESPIX_AUDIO_IO_PSRAM
        bool "Reader and decoder chunk buffers from PSRAM"
        depends on ESPIX_AUDIO
        default y
        help
            Allocate the source read buffer, the decoder output buffer and the
            mono upmix scratch from PSRAM instead of internal RAM. They are
            streamed rather than walked at random, and measured on the S31 with
            an A2DP link up they are *faster* there: freeing the ~14 kB let the
            codec's random-access state stay internal, and the decode went from
            ~0.6x realtime (spilling) to ~11% of a core with the ring full.
            Internal first is the fallback when PSRAM refuses.

    config ESPIX_AUDIO_CODEC_PSRAM
        bool "Allocate the codec's working memory from PSRAM first"
        depends on ESPIX_AUDIO
        default n
        help
            The MP3 decoder's state is random-access, so on the S31 -- whose
            codec library has no DSP path -- internal RAM is load-bearing: with
            the state in PSRAM the decode measured ~1200 ms per second of audio
            against 161 ms with it internal. The S3's codec uses its LX7
            DSP/MAC instructions, which is why it is fast there, so PSRAM may
            be affordable and gives the internal pool back. Set it where it has
            been measured; the default is the S31 behaviour everywhere.

    menu "Codecs"

        # What "play" can decode. Each option selects the esp_audio_codec
        # symbol beneath it, so this menu is the interface and the component's
        # own "Audio Codec Configuration" menu is the escape hatch. The
        # underlying symbols default to y in that component, so every one is
        # set off in sdkconfig.defaults -- otherwise an unselected format links
        # anyway. Re-enabling a format here is what turns it back on.

        menu "Decoders"

            config ESPIX_AUDIO_DEC_MP3
                bool "MP3"
                default y
                select AUDIO_DECODER_MP3_SUPPORT
                help
                    The format "play" is built around, and the only one with a
                    measured decode budget (S31 ~16% of a core, ring full).

            config ESPIX_AUDIO_DEC_WAV
                bool "WAV"
                default y
                select AUDIO_SIMPLE_DEC_WAV_SUPPORT
                help
                    The WAV container, read straight through. No PCM decoder
                    element is needed for it.

            config ESPIX_AUDIO_DEC_AAC
                bool "AAC / M4A (MP4 container)"
                select AUDIO_DECODER_AAC_SUPPORT
                select AUDIO_SIMPLE_DEC_M4A_SUPPORT
                help
                    The second-most-common lossy format, and what most radio
                    streams use. ~120 KiB of image when on.

            config ESPIX_AUDIO_DEC_FLAC
                bool "FLAC"
                select AUDIO_DECODER_FLAC_SUPPORT
                help
                    Lossless, and the cheapest of the extras at ~37 KiB.

            config ESPIX_AUDIO_DEC_OPUS
                bool "Opus (OGG container)"
                select AUDIO_DECODER_OPUS_SUPPORT
                select AUDIO_SIMPLE_DEC_OGG_SUPPORT
                help
                    Modern streaming and WebRTC. On the S31 this is one of the
                    two formats the assembly codec library actually has a PIE
                    path for (LC3 is the other), so it is worth revisiting
                    ESP_AUDIO_CODEC_S31_USE_ASM if this is enabled.

            config ESPIX_AUDIO_DEC_VORBIS
                bool "Vorbis (OGG container)"
                select AUDIO_DECODER_VORBIS_SUPPORT
                select AUDIO_SIMPLE_DEC_OGG_SUPPORT
                help
                    The other OGG radio codec.

            config ESPIX_AUDIO_DEC_TS
                bool "TS (transport stream, HLS)"
                select AUDIO_SIMPLE_DEC_TS_SUPPORT

            config ESPIX_AUDIO_DEC_SBC
                bool "SBC (A2DP sink)"
                select AUDIO_DECODER_SBC_SUPPORT
                help
                    For receiving audio from a phone (A2DP sink), which espix
                    does not implement yet. A2DP *source* uses Bluedroid's own
                    SBC encoder and needs nothing from this menu.

            config ESPIX_AUDIO_DEC_LC3
                bool "LC3 (LE Audio)"
                select AUDIO_DECODER_LC3_SUPPORT
                help
                    LE Audio, phase 3. The other format with an S31 PIE path.

            config ESPIX_AUDIO_DEC_G711
                bool "G.711"
                select AUDIO_DECODER_G711_SUPPORT

            config ESPIX_AUDIO_DEC_G722
                bool "G.722"
                select AUDIO_DECODER_G722_SUPPORT

            config ESPIX_AUDIO_DEC_AMRNB
                bool "AMR-NB"
                select AUDIO_DECODER_AMRNB_SUPPORT

            config ESPIX_AUDIO_DEC_AMRWB
                bool "AMR-WB"
                select AUDIO_DECODER_AMRWB_SUPPORT

            config ESPIX_AUDIO_DEC_ADPCM
                bool "IMA-ADPCM"
                select AUDIO_DECODER_ADPCM_SUPPORT

            config ESPIX_AUDIO_DEC_ALAC
                bool "ALAC"
                select AUDIO_DECODER_ALAC_SUPPORT

            config ESPIX_AUDIO_DEC_PCM
                bool "PCM"
                select AUDIO_DECODER_PCM_SUPPORT

        endmenu

        menu "Encoders"

            # Nothing in espix encodes today. The A2DP source uses Bluedroid's
            # own SBC encoder (BT_A2DP_USE_EXTERNAL_CODEC is off), and the file
            # and network sources only read. An encoder is needed only when
            # espix becomes the source of compressed audio -- an Icecast
            # broadcaster, or an LE Audio source -- so these all default off.

            config ESPIX_AUDIO_ENC_AAC
                bool "AAC"
                select AUDIO_ENCODER_AAC_SUPPORT

            config ESPIX_AUDIO_ENC_OPUS
                bool "Opus"
                select AUDIO_ENCODER_OPUS_SUPPORT

            config ESPIX_AUDIO_ENC_SBC
                bool "SBC"
                select AUDIO_ENCODER_SBC_SUPPORT

            config ESPIX_AUDIO_ENC_LC3
                bool "LC3"
                select AUDIO_ENCODER_LC3_SUPPORT

            config ESPIX_AUDIO_ENC_G711
                bool "G.711"
                select AUDIO_ENCODER_G711_SUPPORT

            config ESPIX_AUDIO_ENC_G722
                bool "G.722"
                select AUDIO_ENCODER_G722_SUPPORT

            config ESPIX_AUDIO_ENC_AMRNB
                bool "AMR-NB"
                select AUDIO_ENCODER_AMRNB_SUPPORT

            config ESPIX_AUDIO_ENC_AMRWB
                bool "AMR-WB"
                select AUDIO_ENCODER_AMRWB_SUPPORT

            config ESPIX_AUDIO_ENC_ADPCM
                bool "IMA-ADPCM"
                select AUDIO_ENCODER_ADPCM_SUPPORT

            config ESPIX_AUDIO_ENC_ALAC
                bool "ALAC"
                select AUDIO_ENCODER_ALAC_SUPPORT

            config ESPIX_AUDIO_ENC_PCM
                bool "PCM"
                select AUDIO_ENCODER_PCM_SUPPORT

        endmenu

    endmenu

endmenu
```

## components/espix_bt/Kconfig
```kconfig
menu "espix bluetooth"

    config ESPIX_BT
        bool "Bluetooth"
        default n
        help
            Bluetooth host, and the `bluetoothctl` command. On a target with
            Bluetooth Classic (S31) this is Bluedroid, which A2DP and HFP
            require; the S3 has BLE only and takes a NimBLE path in phase 2.

            Off by default: Bluedroid Classic is one of the larger things that
            can be linked in. The stack is configured per target in
            sdkconfig.defaults.esp32s31.

    config ESPIX_BT_NAME
        string "Device name"
        depends on ESPIX_BT
        default "espix"
        help
            The name other devices see while discovering.

endmenu
```

## components/espix_fault/Kconfig
```kconfig
menu "espix fault handling"

    config ESPIX_FAULT_REAP
        bool "Reap the faulting task instead of rebooting (NOT IMPLEMENTED)"
        default n
        help
            Placeholder for the "a crashing app does not crash the system"
            path: instead of delegating to ESP-IDF's panic handler (dump and
            reboot), hand the faulting task to the espix reaper and resume.

            This does nothing yet, and turning it on will not change behaviour.
            Before it can, three things need solving — locks held by the dead
            task, per-process ownership of heap/fds so reaping does not leak,
            and deciding which fault classes are recoverable at all. See the
            comments at the top of reaper.c.

endmenu
```
