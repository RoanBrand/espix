## components/espix_ssh/Kconfig
```kconfig
menu "espix SSH"

    config ESPIX_SSH_ENABLED
        bool "Enable the SSH server"
        default y
        help
            A minimal SSH server written on PSA Crypto.

            Note that this is a hand-written implementation of a security
            protocol, not a reviewed one. It is appropriate for a trusted LAN
            and inappropriate for exposure to the internet.

    config ESPIX_SSH_PORT
        int "Listen port"
        depends on ESPIX_SSH_ENABLED
        range 1 65535
        default 22

    config ESPIX_SSH_MAX_SESSIONS
        int "Concurrent connections"
        depends on ESPIX_SSH_ENABLED
        range 1 16
        default 8
        help
            How many SSH connections may be open at once.

            Two is the useful minimum: scp and sftp open their own connection,
            so with a limit of one no file could be transferred while an
            interactive session was open.

            Eight is the default because the test harness runs suites in
            parallel over several sessions at once, each of which may open a
            second connection for a transfer or an exit status. Four -- the old
            default -- gave four workers no headroom at all.

            The cost is internal RAM, and only while a connection is actually
            open: nothing here is preallocated. With the PSRAM options below on,
            which is the default, a connection costs 12392 bytes of internal
            RAM -- its task stack, which can never live in PSRAM, and the
            channel receive buffer. Everything else, 14760 bytes of packet
            buffers and key-exchange state plus about 15KB more while a transfer
            is running, comes from PSRAM.

            Measured on an N16R8 rather than added up, because the sum leaves
            things out -- an lwIP socket and the session's own state put the
            real figure nearer 12K. Idle, `free` reports 146K of internal heap
            free with a 72K largest block. With eight connections open it
            reports 50K free, a 31K largest block, and 39K as the minimum since
            boot; closing them returns it to 144K, so nothing here leaks.

            That is the reason for the default and for the shape of the range.
            Eight fits with about 50K to spare. Sixteen would want 192K on a
            board that has 146K, so the range top is a ceiling for
            configurations this code must survive and not a recommendation:
            over-asking degrades into refused connections rather than a crash,
            but it degrades. tests/suites/55-sessions.sh takes these numbers
            again on the real device instead of trusting this paragraph.

            Without PSRAM all of it falls back to internal RAM, roughly 25KB per
            idle connection, and anything above two or three will not fit.

    config ESPIX_SSH_TASK_STACK
        int "Connection task stack (bytes)"
        depends on ESPIX_SSH_ENABLED
        range 4096 16384
        default 6144
        help
            The protocol logic is shallow, but the handshake is not: x25519,
            ECDSA and PBKDF2 run here, and a live session measured 4056 bytes
            used -- handshake, prompt and a command together.

            Commands do not run here unless they say they can. `espix_cmd_t` has
            a `stack` field, and a command that declares a size runs on a task of
            its own: sized for it, freed when it exits, never charged to every
            open connection. The shell used to run on this stack, which cost
            10240 per connection and was still not enough for lwext4's mount --
            `sudo mount -o ro sda3 /media/s3` tripped the canary and the core
            dump named this task. It had already happened once before, at 8192,
            on `sudo mount sda1 /mnt/sd1`.

            So this number is the protocol plus the commands that run inline, and
            the deep ones pay for themselves. Raising it is still the wrong fix
            for a command that needs more: declare the size in the command table,
            where it costs one command's stack instead of every session's.

            Sizing is measured, not guessed. `ps` shows a running task's
            high-water mark, and the dispatcher logs the same figure for a
            spawned command as it finishes -- `dmesg` is where to read what a
            command actually used.

            Raising this raises the per-connection internal cost in the note
            above by the same amount: 10344 becomes 12392, so eight open
            connections want about 16K more than the figures there were measured
            with.

    config ESPIX_SSH_SFTP_IN_PSRAM
        bool "Allocate SFTP transfer buffers from PSRAM when available"
        depends on ESPIX_SSH_ENABLED
        default y
        help
            The SFTP session buffers are the largest allocation the SSH server
            makes and exist only while a file is being transferred. Nothing in
            them is a DMA target -- recv() copies out of lwIP's own buffers --
            so external RAM is safe here.

            Falls back to internal RAM, so a board without PSRAM behaves
            identically, only with less of it to spare.

    config ESPIX_SSH_CONN_IN_PSRAM
        bool "Allocate the per-connection state from PSRAM when available"
        depends on ESPIX_SSH_ENABLED
        default y
        help
            Moves the 14760 bytes of packet buffers, cipher state and stored
            key-exchange material per connection out of internal RAM, which is
            what limits how many sessions fit. A connection then costs 12392
            bytes of internal RAM: its task stack, which can never leave
            internal RAM, and the channel receive buffer.

            This holds the cipher state and both packet buffers, and the AES
            driver bounces external memory through an internal buffer before
            using it (mbedtls/port/aes/dma/esp_aes_dma_core.c), so it was off
            until the cost was measured. On an N16R8 over 2.4GHz WiFi the cost
            is not measurable: download medians 175.6 KB/s against 172.3 with
            the state in internal RAM (n=10 each), and login-to-prompt, which
            is dominated by ECDH and ECDSA, is 4.08s against 4.07s. Internal
            use per connection fell 13KB and the largest free internal block
            rose from 84KB to 104KB.

            The caveat is that at ~175KB/s the CPU is not saturated by bulk
            AES, so a small per-block penalty would not show. A much faster
            link could expose one.

    config ESPIX_SSH_TASK_PRIO
        int "SSH task priority"
        depends on ESPIX_SSH_ENABLED
        range 1 10
        default 4
        help
            Above loaded apps so a busy app cannot starve a login, below the
            console so the serial line stays usable as a recovery path.

endmenu
```

## components/espix_usb/Kconfig
```kconfig
menu "espix usb"

    config ESPIX_USB_VERBOSE
        bool "Verbose USB host logging"
        depends on ESPIX_USB_ROLE_HOST
        default n
        help
            Raise the USB stack's own log tags to DEBUG, so `dmesg` shows what
            the host library and the class drivers think is happening: port
            changes, what was enumerated and at what speed, and why a device was
            not claimed by any driver.

            This is the switch to reach for when a device does not appear. The
            stack logs everything useful at DEBUG and almost nothing at INFO, so
            with this off a working enumeration and an empty socket look
            identical -- which is exactly the question it exists to answer.

            Two halves, and both are needed. CONFIG_LOG_MAXIMUM_LEVEL (DEBUG, in
            sdkconfig.defaults) decides whether the messages exist in the image
            at all; this option raises the tags that are noisy enough to be worth
            leaving off by default.

            Costs nothing when off, and when on it costs log volume: the kernel
            log ring holds 96 lines (ESPIX_KLOG_LINES) and this will fill it.
            Nothing else in the system is raised -- WiFi, lwip and the app loader
            keep their own levels.

    config ESPIX_USB_VERIFY_READS
        int "Verify this many block reads after boot"
        depends on ESPIX_USB_ROLE_HOST
        default 0
        range 0 100000
        help
            Verify the first N block reads after boot: each is read a second
            time and compared, and a read whose verification disagrees is
            re-read until two consecutive reads agree (or failed after four
            tries). 0 disables it.

            This exists because a device can return wrong data and report success,
            and nothing above the block device can tell. The filesystems do notice
            -- FatFs reports FR_INT_ERR from exFAT's entry-set checksum, lwext4
            logs a failed directory checksum -- but neither says whether the
            medium lied or the read failed, and a listing that stopped early looks
            exactly like a short directory.

            A majority vote is deliberately NOT used: a device that returns the
            same wrong bytes to every read wins the vote and the lie is returned
            as success. Two reads that agree is the strongest claim available
            without a checksum on the medium.

            It costs a second read of every verified transfer, so it is bounded
            and off by default: on a 12 Mbps link that is expensive, and a mount's
            first accesses are where the damage was measured (the first 200). Set
            it to cover that, reboot, read `dmesg`, and turn it off again. See
            docs/KNOWN-ISSUES.md.

endmenu
```

## main/Kconfig.projbuild
```kconfig
menu "espix tracing"

    config ESPIX_TRACE_CORE
        int "SystemView: CPU whose scheduling is traced (0 or 1)"
        depends on ESP_TRACE_LIB_EXTERNAL
        range 0 1
        default 0
        help
            The USB-Serial/JTAG transport carries one SystemView stream, so the
            encoder can represent the scheduling events of one CPU only; the
            other CPU's task and ISR state changes are dropped. espix pins
            espix:vnc to CPU1, so profiling the desktop/display path wants 1 and
            the network/ssh side wants 0. The JTAG transport is multi-core and
            ignores this, but S31 apptrace does not work in OpenOCD yet.
            See docs/PROFILING.md.

endmenu
```
