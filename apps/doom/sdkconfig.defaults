## components/espix_net/Kconfig
```kconfig
menu "espix networking"

    choice ESPIX_USB_ROLE
        prompt "What the USB-OTG port is"
        depends on SOC_USB_OTG_SUPPORTED
        default ESPIX_USB_ROLE_HOST
        help
            A board with one general-purpose USB controller cannot be both a
            device and a host: the OTG peripheral is a singleton, and
            SOC_USB_OTG_PERIPH_NUM above says how many this chip has. espix picks
            one role at build time rather than pretending otherwise, because the
            two stacks do not coexist in the link either.

            The P4 is the only espix target with two (SOC_USB_OTG_PERIPH_NUM is
            2 there), and this choice still applies to it: the wiring of one
            board's two sockets is not something software can discover.

    config ESPIX_USB_ROLE_HOST
        bool "host -- espix drives attached devices"
        help
            The OTG port powers and enumerates devices plugged into it: storage
            first (`lsblk`, `blkid`), a keyboard later. This is the default
            because a machine that calls itself a server should have a host
            port.

            Two consequences worth knowing before flashing it. usb0 disappears
            from the image, so a board that was reachable over the cable is not
            any more -- WiFi and SSH are the way in. And on a devkit whose two
            sockets sit close together, a hub in the OTG socket can block the
            UART socket, which leaves SSH as the only console; unplugging the
            hub is the recovery, not a reflash.

    config ESPIX_USB_ROLE_DEVICE
        bool "device -- USB-NCM ethernet (usb0)"
        help
            Presents the board to a computer as a USB Ethernet adapter. See
            `espix networking` below for the mode and address options; they are
            unchanged, they simply only apply to this role.

    endchoice

    config ESPIX_USB_NCM_ENABLED
        bool "USB-NCM (Ethernet over the USB-OTG port)"
        default y
        depends on ESPIX_USB_ROLE_DEVICE
        help
            Presents the board to a computer as a USB Ethernet adapter, so it
            is reachable over the cable with no WiFi, no access point and no
            router. The interface is usb0, and it goes up and down as the cable
            is plugged and unplugged.

            This does not touch the console. espix's console is the UART, with
            USB-Serial-JTAG as a secondary; neither uses the USB-OTG peripheral
            this claims, and on a devkit with two sockets both work at once.

            Turning it off drops espix's driver and the whole TinyUSB stack from
            the link, which is where the flash and RAM go. The component is
            still downloaded either way -- the component manager resolves
            manifests before Kconfig exists, so it cannot see this option.

    choice ESPIX_USB_NCM_MODE_DEFAULT
        prompt "Default mode, before /etc/usb.conf exists"
        depends on ESPIX_USB_NCM_ENABLED
        default ESPIX_USB_NCM_MODE_SERVER
        help
            What usb0 does on a device that has never been configured.
            /etc/usb.conf overrides this, and `usb mode` writes that file.

        config ESPIX_USB_NCM_MODE_SERVER
            bool "server -- espix hands the computer an address"
            help
                espix takes a fixed address and runs a DHCP server on usb0, so
                plugging the cable in is all it takes to reach the board. The
                offer carries an address and netmask only: no router and no DNS,
                because espix is not a router and a gateway in that offer can
                take over the computer's default route and break its internet.

        config ESPIX_USB_NCM_MODE_CLIENT
            bool "client -- espix asks the computer's network for one"
            help
                espix runs a DHCP client on usb0. For a computer that bridges or
                shares its own network over the USB link, which is how the board
                joins a LAN through the machine it is plugged into.

    endchoice

    config ESPIX_USB_NCM_ADDRESS
        string "Address for server mode"
        depends on ESPIX_USB_NCM_ENABLED
        default "192.168.7.1"
        help
            espix's own address on usb0 in server mode; the computer is offered
            one from the same /24.

            192.168.7.x rather than 192.168.4.x, which is ESP-IDF's WiFi access
            point default -- keeping them apart means a future AP cannot collide
            with the USB link.

    #
    # Ethernet. The S31 has a Gigabit MAC and needs an external PHY; the S3 has
    # no wired peripheral at all, so SOC_EMAC_SUPPORTED is what makes this
    # visible and the S3 build never sees it. Default on for the S31 alone: it
    # is the target this was written for, and the P4's MAC is a different
    # interface that has not been brought up.
    #
    config ESPIX_ETH_ENABLED
        bool "Ethernet (eth0)"
        depends on SOC_EMAC_SUPPORTED
        default y if IDF_TARGET_ESP32S31
        default n
        help
            Brings up the internal EMAC and an external PHY as eth0, a DHCP
            client like wlan0. It is named and registered like any other
            interface, and when both it and wlan0 have an address the default
            route prefers Ethernet.

            Off on the P4 for now. Its MAC is a 100M RMII interface, not the
            S31's RGMII, so it needs its own configuration first.

    if ESPIX_ETH_ENABLED
        config ESPIX_ETH_MDC_GPIO
            int "SMI MDC GPIO"
            range 0 60
            default 5
            help
                Management clock of the PHY's SMI bus. The S31 has no dedicated
                IO_MUX pin for it, so any free GPIO will do.

        config ESPIX_ETH_MDIO_GPIO
            int "SMI MDIO GPIO"
            range 0 60
            default 6

        config ESPIX_ETH_PHY_ADDR
            int "PHY address (-1 probes 0..31)"
            range -1 31
            default -1

        config ESPIX_ETH_PHY_RST_GPIO
            int "PHY reset GPIO (-1 for none)"
            range -1 60
            default 7

        config ESPIX_ETH_PHY_YT8531
            bool "YT8531 RGMII fix-ups"
            default y
            help
                The S31 reference board's PHY is a Motorcomm YT8531, which needs
                two things the generic 802.3 driver cannot know: auto-negotiation
                is disabled by its hardware reset and must be switched back on,
                and RGMII needs about 2 ns of Tx and Rx internal clock delay.
                Both are written through the generic driver's register ioctls.

                Turn this off for a different PHY and set the pins above to match.

        config ESPIX_ETH_RGMII_TX_CLK_GPIO
            int "RGMII TX_CLK GPIO"
            range 0 60
            default 13

        config ESPIX_ETH_RGMII_RX_CLK_GPIO
            int "RGMII RX_CLK GPIO"
            range 0 60
            default 14

        config ESPIX_ETH_RGMII_PHY_REF_CLK_GPIO
            int "RGMII PHY 50 MHz reference clock GPIO (-1 for none)"
            range -1 60
            default -1

        config ESPIX_ETH_RGMII_TX_CTL_GPIO
            int "RGMII TX_CTL GPIO"
            range 0 60
            default 12

        config ESPIX_ETH_RGMII_TXD0_GPIO
            int "RGMII TXD0 GPIO"
            range 0 60
            default 8

        config ESPIX_ETH_RGMII_TXD1_GPIO
            int "RGMII TXD1 GPIO"
            range 0 60
            default 9

        config ESPIX_ETH_RGMII_TXD2_GPIO
            int "RGMII TXD2 GPIO"
            range 0 60
            default 10

        config ESPIX_ETH_RGMII_TXD3_GPIO
            int "RGMII TXD3 GPIO"
            range 0 60
            default 11

        config ESPIX_ETH_RGMII_RX_CTL_GPIO
            int "RGMII RX_CTL GPIO"
            range 0 60
            default 15

        config ESPIX_ETH_RGMII_RXD0_GPIO
            int "RGMII RXD0 GPIO"
            range 0 60
            default 19

        config ESPIX_ETH_RGMII_RXD1_GPIO
            int "RGMII RXD1 GPIO"
            range 0 60
            default 18

        config ESPIX_ETH_RGMII_RXD2_GPIO
            int "RGMII RXD2 GPIO"
            range 0 60
            default 17

        config ESPIX_ETH_RGMII_RXD3_GPIO
            int "RGMII RXD3 GPIO"
            range 0 60
            default 16
    endif

    #
    # Routing and NAT: the basis of an AP that provides internet, and of a
    # wired client NATed through WiFi. The lwIP options are selected rather
    # than suggested, so NAPT cannot be half-set (it depends on forwarding).
    #
    # This is not a firewall: nothing is blocked by turning it on, and it is
    # per-interface (`nat on <inside>`) rather than a policy.
    #
    config ESPIX_NET_ROUTER
        bool "Router (IPv4 forwarding and NAT)"
        select LWIP_IP_FORWARD
        select LWIP_IPV4_NAPT
        default y
        help
            Lets espix forward between its interfaces and masquerade one
            behind another. A WiFi AP whose clients reach the internet
            through the uplink, or a wired client NATed through WiFi, need
            this.

            Off removes lwIP's forwarding and NAT code and hides the `nat`
            command: espix is then a host, not a router.

endmenu
```

## components/espix_ota/Kconfig
```kconfig
menu "espix OTA"

    config ESPIX_OTA_ENABLED
        bool "Firmware updates over the network"
        default y if ESPTOOLPY_FLASHSIZE_16MB || ESPTOOLPY_FLASHSIZE_8MB
        default n
        help
            Compiles the `upgrade` command and the background update check.
            The partition table must have ota_0 (the kernel), ota_1 (the loader)
            and otadata, which both the 8MB and 16MB tables do. A build with
            this on and no loader slot refuses to update and says so.

    config ESPIX_OTA_AUTO_CHECK
        bool "Check for updates in the background"
        depends on ESPIX_OTA_ENABLED
        default y
        help
            A low-priority task checks at most once per
            ESPIX_OTA_CHECK_PERIOD_S, woken by the network getting an address,
            and never in the boot path. It never installs anything: the result
            only makes the greeting mention that an update exists.

    config ESPIX_OTA_CHECK_PERIOD_S
        int "Minimum seconds between background checks"
        depends on ESPIX_OTA_AUTO_CHECK
        range 3600 604800
        default 86400

    config ESPIX_OTA_ALLOW_HTTP
        bool "Allow plain-HTTP update sources (development)"
        depends on ESPIX_OTA_ENABLED
        default n
        select ESP_HTTPS_OTA_ALLOW_HTTP
        help
            Lets a development board pull from a laptop's HTTP server. Off by
            default: a release should fetch over TLS, and this is the one switch
            that makes the transport unauthenticated.

    config ESPIX_OTA_TIMEOUT_MS
        int "Network timeout (ms)"
        depends on ESPIX_OTA_ENABLED
        range 1000 300000
        default 30000

    config ESPIX_OTA_BASE_URL
        string "Update manifest base URL"
        depends on ESPIX_OTA_ENABLED
        default "https://github.com/RoanBrand/espix/releases/latest/download"
        help
            The device fetches <base>/espix-ota.json and finds its own entry
            under its board identity -- `s3-r8`/`s3-r2`, or plain `s31`. One
            base URL serves every target, and a release carries one merged
            manifest. /etc/espix.conf `ota.url=` overrides the whole URL, for
            pinning a version or pointing at a development server.

endmenu
```

## components/espix_proc/Kconfig
```kconfig
menu "espix processes"

    config ESPIX_PROC_MAX
        int "Maximum tracked processes"
        range 2 64
        default 32
        help
            Size of the espix process table: the limit on processes alive at
            once. A finished process copies what a listing needs into the
            completed log (see espix_proc_history()) and releases its slot, so
            this bounds concurrency and nothing else.

            A slot is about 224 bytes of internal RAM. What only an ELF app
            needs -- its image, argv, environment and paths -- is a block in
            PSRAM it gets at spawn, so daemons and kernel threads, which have
            pids too, cost the slot alone.

    config ESPIX_PTHREAD_MAX
        int "Maximum threads, across all processes"
        range 4 64
        default 32
        help
            Size of the table that ties a thread to its process -- an app's
            pthreads, and espix's own (sshd:rx, audio's mixer) -- so a signal
            reaches them and the process's end can end them. One table for the
            whole system, 20 bytes an entry; pthread_create beyond it fails with
            EAGAIN rather than starting a thread nobody can reach.

    config ESPIX_PROC_STACK_SIZE
        int "Default stack size for a loaded app (bytes)"
        range 2048 524288
        default 8192
        help
            Stack given to the task that relocates and runs an ELF app. Apps
            run on this stack, so it must accommodate the deepest call chain
            the app makes, including printf.

    config ESPIX_PROC_PRIORITY
        int "Priority for loaded app tasks"
        range 1 10
        default 3
        help
            Above the console session, which runs on main_task at priority 1,
            so a newly created app preempts the shell that started it. proc_task
            waits on the process lock at entry because of that; see the comment
            there before changing this.

    config ESPIX_PROC_ABI_WATCHPOINT
        bool "Watch the ABI resolver state for stray writes"
        default y
        help
            Arm a hardware watchpoint on the symbol resolver's table state, so a
            write to it from anywhere panics at the instruction that did it.

            This exists because that state was found corrupted on a running
            board: apps could no longer resolve getenv(), which the resolver
            publishes, while getpid() from the table registered before it still
            worked. The resolver had been left searching one table instead of
            two, and it stayed that way until reboot.

            s_table_count sits immediately after g_espix_procs in .bss, so a
            single word written one past the process table lands on it. Nothing
            rewrites it afterwards, so the damage is silent and permanent, and
            it surfaces an hour later as a missing symbol.

            Costs one of the ESP32-S3's two watchpoints. Turn it off only if
            something else needs both.

    config ESPIX_PROC_IMAGE_IN_PSRAM
        bool "Read app images into PSRAM when available"
        default y
        help
            Allocate the buffer holding the ELF file from PSRAM, falling back to
            internal RAM. Independent of ELF_LOADER_LOAD_PSRAM, which controls
            where the *relocated* image lives.

endmenu
```
