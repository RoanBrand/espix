## components/espix_fs/Kconfig
```kconfig
menu "espix filesystem"

    config ESPIX_FS_EXFAT
        bool "exFAT support in the FAT driver"
        default n
        help
            FatFs reads and writes exFAT as well as FAT12/16/32, but ESP-IDF
            ships it off: ffconf.h hard-codes FF_FS_EXFAT to 0 and exposes no
            Kconfig for it, unlike the options beside it. Enabling this patches
            that line to follow this symbol, so it is a build choice rather
            than an edit to the IDF tree.

            It also turns on FF_LBA64, which is not optional for the volumes
            exFAT is wanted for: ff.c refuses any volume whose last LBA does not
            fit in 32 bits, which at a 512-byte sector is 2TiB. Without it an
            exFAT partition larger than that mounts as FR_NO_FILESYSTEM.

            Two more 32-bit fields had to widen with it, both in the IDF tree
            and both silent when left alone: the diskio read/write function
            pointers in diskio_impl.h, and the sector parameters and ioctl
            buffers in diskio_bdl.c. See tools/patch-fatfs.py.

            With it on, `mount` accepts a volume lsblk names exfat and lsblk
            stops marking that type unsupported -- the driver is there, so the
            marker would be a lie.

            The cost, measured on the S3 build with idf.py size -- this option n
            against the same tree with it y, so the delta is the whole feature
            rather than one patch of it:

              total image   1347280 -> 1354252    +6972 bytes
              .bss            59528 -> 59528      no change
              .data           26503 -> 26503      no change

            The earlier figure for FF_FS_EXFAT alone was +5644; the rest is
            FF_LBA64. Nothing shows in .bss because a FATFS work area is
            allocated rather than static, so the RAM cost sits on the heap at
            mount. Expect a 3TB volume to allocate a few KB more there and to
            spend a moment reading its allocation bitmap the first time free
            space is asked for.

            Licensing: exFAT is covered by Microsoft patents, and FatFs's author
            has historically noted that a licence may be needed for commercial
            use. No patent or licence text ships with IDF's FatFs, and that claim
            has not been verified here -- check the terms before shipping this on
            by default.

    config ESPIX_FS_EXT4
        bool "ext2/3/4 support (read-only)"
        default n
        help
            Mounts ext2, ext3 and ext4 as the third filesystem, after littlefs
            and FAT/exFAT. The library is lwext4, vendored as the esp_lwext4
            component in components/esp_lwext4, and its driver is espix's own --
            components/espix_fs/ext.c, in the shape of fat.c -- so a mount made
            here goes through espix's VFS and its permission check rather than
            being reachable around it.

            Read-only. ext4_mount() takes read_only as an argument and every
            mutating operation refuses with EROFS, so the two agree by
            construction. Writes need the vendored lwext4's write-path defect
            dealt with first; see docs/ROADMAP.md.

            One thing this gets that the FAT driver cannot: stat with a real
            inode behind it. Mode, owner and timestamps come from the inode
            rather than from a mount-wide uid=/gid= rule, and df is lwext4's own
            count rather than arithmetic over a FAT. The exception is size, which
            is truncated at 4 GiB like everything else while off_t is 32 bits --
            see docs/UPSTREAM.md.

            With it on, lsblk stops marking ext2/ext3/ext4 unsupported and `mount`
            accepts it, on the same rule as exFAT: the driver is there, so the
            marker would be a lie.

            The cost, measured the way the exFAT option above was -- this option
            n against the same tree with it y, so the delta is the whole feature:

              total image   1355960 -> 1475820    +119860 bytes
              .text          968970 -> 1083550    +114580
              .rodata        259956 ->  265220      +5264
              .bss            59576 ->   70008     +10432
              .data           26519 ->   26535        +16
              DIRAM .text     83839 ->   83839          0

            The last line is the one that matters most: no IRAM, which is the
            first thing to run out here and is already at its whole 16KB. Nothing
            lwext4 needs is time-critical enough to be placed there, and its
            block cache is a heap allocation rather than a static array.

            The .bss is the largest of the rest and is mostly espix's own handle
            table -- eight open files or directories at once, each holding an
            ext4_dir of 320 bytes and a struct dirent of 260 even when it is a
            file. A union would cut about 1.4KB of it back, and has not been done
            yet.

            lwext4 carries the extents and journal code either way, because
            CONFIG_LWEXT4_FEATURE_SET_EXT4 is what a Linux volume needs -- an
            ext4 filesystem has the extents feature and the ext2 or ext3 set
            would refuse it.

endmenu

    config ESPIX_FS_EXT4_FAIL_WRITE_ABOVE
        int "Refuse the first block write at or above this address (0 = off)"
        depends on ESPIX_FS_EXT4
        default 0
        help
            Injects one I/O failure into the block device under a mounted ext
            volume: the first write at or above this byte address is refused,
            once, which is what a medium that has stopped answering looks like.

            It exists because the question it answers -- whether lwext4 aborts
            its transaction and reports the failure, or commits over it -- cannot
            be asked any other way, and because a passing e2fsck is not evidence
            about it.

            An address rather than a count of writes, because a count cannot
            distinguish a failed metadata write from a failed file data write --
            and lwext4 simply reissues the former, so a test aimed at a count
            proves nothing. On a volume laid out like the one this was written
            against, metadata sits low (0x400, 0x1000) and data high (0x8800...),
            so 0x80000000 aims at a data write. Zero, the default, is off.
```

## components/espix_i2s/Kconfig
```kconfig
menu "espix i2s"

    config ESPIX_I2S
        bool "I2S codec sink and source (S31 function coreboard's ES8311)"
        default n
        help
            The ES8311 on the S31 function coreboard, over I2S and I2C, with the
            NS4150B PA and the on-board electret. Registers an "es8311" sink at
            boot, so the board has a speaker that does not need Bluetooth, and an
            "es8311" source for `record`. The codec is opened lazily, on the
            first stream in its direction.

            The defaults below are that board's, and they are not shared: the
            S31 Korvo-1 has an ES8389 with two amplifiers (stereo), its I2C on
            GPIO 0/1, its I2S on 3/4/5/6, no MCLK at all, and its PA on GPIO 7.
            A second board means a second set of these values, not a tweak to
            this one.

    if ESPIX_I2S

    choice ESPIX_I2S_BOARD
        prompt "Board"
        default ESPIX_I2S_BOARD_COREBOARD
        help
            The audio wiring is per board, not per chip: these two share an
            ESP32-S31 and agree about nothing else on the path. Selecting the
            wrong one drives the codec's bus at some other pin.

    config ESPIX_I2S_BOARD_COREBOARD
        bool "S31 function coreboard (ES8311, mono)"
    config ESPIX_I2S_BOARD_KORVO_1
        bool "S31 Korvo-1 (ES8389, stereo)"
    endchoice

    config ESPIX_I2S_I2C_PORT
        int "I2C port"
        default 0
    config ESPIX_I2S_I2C_SDA
        int "I2C SDA GPIO"
        default 51 if ESPIX_I2S_BOARD_COREBOARD
        default 0  if ESPIX_I2S_BOARD_KORVO_1
    config ESPIX_I2S_I2C_SCL
        int "I2C SCL GPIO"
        default 50 if ESPIX_I2S_BOARD_COREBOARD
        default 1  if ESPIX_I2S_BOARD_KORVO_1

    # -1 means the board has no MCLK net, which the Korvo does not.
    config ESPIX_I2S_MCLK
        int "I2S MCLK GPIO (-1 for none)"
        default 52 if ESPIX_I2S_BOARD_COREBOARD
        default -1 if ESPIX_I2S_BOARD_KORVO_1
    config ESPIX_I2S_BCLK
        int "I2S BCLK GPIO"
        default 53 if ESPIX_I2S_BOARD_COREBOARD
        default 3  if ESPIX_I2S_BOARD_KORVO_1
    config ESPIX_I2S_WS
        int "I2S WS GPIO"
        default 55 if ESPIX_I2S_BOARD_COREBOARD
        default 4  if ESPIX_I2S_BOARD_KORVO_1
    config ESPIX_I2S_DOUT
        int "I2S DOUT GPIO (ESP -> codec)"
        default 56 if ESPIX_I2S_BOARD_COREBOARD
        default 5  if ESPIX_I2S_BOARD_KORVO_1
    config ESPIX_I2S_DIN
        int "I2S DIN GPIO (codec -> ESP)"
        default 54 if ESPIX_I2S_BOARD_COREBOARD
        default 6  if ESPIX_I2S_BOARD_KORVO_1
    config ESPIX_I2S_PA
        int "PA enable GPIO (active high)"
        default 57 if ESPIX_I2S_BOARD_COREBOARD
        default 7  if ESPIX_I2S_BOARD_KORVO_1

    config ESPIX_I2S_DEFAULT_VOL
        int "Startup output volume (0-100)"
        default 70

    config ESPIX_I2S_INPUT_GAIN_DB
        int "Microphone gain (dB)"
        range 0 42
        default 42
        help
            The ES8311 ADC's programmable gain, in 6 dB steps. The on-board
            electret is quiet, so the maximum is the default; lower it if a
            capture clips.

    config ESPIX_I2S_ADC_ALC
        bool "Automatic level control on the microphone"
        default n
        help
            The ES8311's ALC: a quiet input is lifted toward the max level and a
            loud one is held back. Measured on the S31 coreboard's microphone it
            costs more than it gives -- its gain ramps at startup, so the first
            second clipped while the same second was the quietest without it,
            and its release is slow enough to duck everything after a burst
            below the no-ALC level. Off by default; a close-talking voice case
            may suit it, and a fixed gain in software is the predictable
            alternative. The values below are the codec's own fields.

    config ESPIX_I2S_ADC_ALC_WINSIZE
        int "ALC window size (0-15, longer is slower)"
        depends on ESPIX_I2S_ADC_ALC
        range 0 15
        default 6

    config ESPIX_I2S_ADC_ALC_MAXLEVEL
        int "ALC max level index (0 = -30.1 dBFS, 15 = -6.0 dBFS)"
        depends on ESPIX_I2S_ADC_ALC
        range 0 15
        default 9

    config ESPIX_I2S_ADC_ALC_MINLEVEL
        int "ALC min level index (0 = -30.1 dBFS, 15 = -6.0 dBFS)"
        depends on ESPIX_I2S_ADC_ALC
        range 0 15
        default 0

    endif

endmenu
```

## components/espix_kernel/Kconfig
```kconfig
menu "espix kernel"

    config ESPIX_KLOG_LINES
        int "Kernel log ring size (lines)"
        range 8 512
        default 256
        help
            Number of lines retained by the kernel log ring that backs `dmesg`.

            A line costs ESPIX_KLOG_LINE_MAX + ~16 bytes: 96 lines is about
            12 kB and 256 about 34 kB. It is PSRAM that pays -- klog.c asks for
            MALLOC_CAP_SPIRAM with an internal fallback, and the measurement
            agrees: raising this from 96 to 256 left internal usage unchanged
            (247 kB used either way), so the extra 21 kB came from the pool with
            13 MB in it rather than the one audio, lwIP and the USB host share.

            A ring that wraps loses exactly the lines a fault is read for: at
            96, dmesg reported "507 earlier lines dropped" during one hunt.

    config ESPIX_KLOG_QUIET
        bool "Keep kernel log lines out of the console (dmesg only)"
        default n
        help
            By default espix_klog() output goes to stdout as well as to the ring,
            the way a Linux kernel prints to the console as well as to kmsg.
            Enable this to make the kernel log visible only through `dmesg`.

            Lines captured from ESP_LOGx are never echoed either way — they are
            already heading for the console on their own.

            Phrased as an opt-out rather than an opt-in on purpose: an undefined
            bool is indistinguishable from 'n', so a default-y option silently
            disables itself if the sdkconfig ever fails to regenerate. This way
            the failure mode is the behaviour we want.

    config ESPIX_KLOG_CAPTURE_ESP_LOG
        bool "Capture ESP-IDF log output into the kernel log"
        default y
        help
            Install an esp_log_set_vprintf() hook so ESP_LOGx output from
            ESP-IDF and its components also lands in `dmesg`. Output still goes
            to the console as normal.

    config ESPIX_PSRAM_MB
        int "PSRAM size in MB (0 if none)"
        default 0
        help
            The module's PSRAM size, which ESP-IDF cannot know: on the S3 the
            size is auto-detected at runtime, so R2 and R8 modules share one
            sdkconfig. espix uses it for exactly one thing -- the board identity
            it is built for (model and PSRAM size, e.g. `s3-r8`), which names the
            release assets and the manifest entry the device reads. Flash size is
            deliberately not part of it. Nothing branches on it.

endmenu
```
