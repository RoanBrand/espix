#include <stdio.h>
#include <string.h>
#include "vnc_des.h"

static int one(const char *name,
               const uint8_t k[8], const uint8_t p[8], const uint8_t want[8])
{
    uint8_t got[8];
    espix_vnc_des_encrypt(k, p, got);
    if (memcmp(got, want, 8) != 0) {
        printf("FAIL %-8s got ", name);
        for (int i = 0; i < 8; i++) printf("%02X", got[i]);
        printf(" want ");
        for (int i = 0; i < 8; i++) printf("%02X", want[i]);
        printf("\n");
        return 1;
    }
    printf("ok   %s\n", name);
    return 0;
}

int main(void)
{
    int bad = 0;

    /* The two published tutorial vectors. */
    bad += one("fips-1",
        (const uint8_t[]){0x13,0x34,0x57,0x79,0x9B,0xBC,0xDF,0xF1},
        (const uint8_t[]){0x01,0x23,0x45,0x67,0x89,0xAB,0xCD,0xEF},
        (const uint8_t[]){0x85,0xE8,0x13,0x54,0x0F,0x0A,0xB4,0x05});
    bad += one("fips-2",
        (const uint8_t[]){0x01,0x23,0x45,0x67,0x89,0xAB,0xCD,0xEF},
        (const uint8_t[]){0x4E,0x6F,0x77,0x20,0x69,0x73,0x20,0x74},
        (const uint8_t[]){0x3F,0xA4,0x0E,0x8A,0x98,0x4D,0x48,0x15});

    /*
     * And four generated independently, with
     *   openssl enc -des-ecb -K <key> -nopad -provider default -provider legacy
     * which is the point of them: an implementation checked only against itself
     * agrees with itself. vnc_des.c is not built by the firmware -- this file
     * is here so the vectors are reproducible, and is run on the host.
     */
    bad += one("ossl-1",
        (const uint8_t[]){0x01,0x23,0x45,0x67,0x89,0xAB,0xCD,0xEF},
        (const uint8_t[]){0x20,0x20,0x20,0x20,0x20,0x20,0x20,0x20},
        (const uint8_t[]){0xE2,0x2E,0xED,0x5B,0x69,0xA2,0x1A,0x5C});
    bad += one("ossl-2",
        (const uint8_t[]){0x0E,0x32,0x92,0x32,0xEA,0x6D,0x0D,0x73},
        (const uint8_t[]){0x87,0x87,0x87,0x87,0x87,0x87,0x87,0x87},
        (const uint8_t[]){0x00,0x00,0x00,0x00,0x00,0x00,0x00,0x00});
    bad += one("ossl-3",
        (const uint8_t[]){0x55,0x55,0x55,0x55,0x55,0x55,0x55,0x55},
        (const uint8_t[]){0x55,0x55,0x55,0x55,0x55,0x55,0x55,0x55},
        (const uint8_t[]){0x3B,0xCD,0xD4,0x1E,0x61,0x65,0xA5,0xE8});
    bad += one("ossl-4",
        (const uint8_t[]){0xFF,0xFF,0xFF,0xFF,0xFF,0xFF,0xFF,0xFF},
        (const uint8_t[]){0x00,0x00,0x00,0x00,0x00,0x00,0x00,0x00},
        (const uint8_t[]){0xCA,0xAA,0xAF,0x4D,0xEA,0xF1,0xDB,0xAE});

    printf(bad ? "DES: FAILED\n" : "DES: all 6 vectors pass\n");
    return bad;
}
